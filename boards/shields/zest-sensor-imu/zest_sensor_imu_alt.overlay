/*
 * Copyright (c) 2023 CATIE
 *
 * SPDX-License-Identifier: Apache-2.0
 */

#include "zest_sensor_imu_4.0.0_alt.overlay"

#define ZEST_SENSOR_IMU_4_0_0_ALT(port, ism330dhcx_irq, iis2mdc_irq) \
	PERIPHERAL_ZEST_SENSOR_IMU_ALT(port) \
	DRIVERS_ZEST_SENSOR_IMU_ALT(port, ism330dhcx_irq, iis2mdc_irq)
