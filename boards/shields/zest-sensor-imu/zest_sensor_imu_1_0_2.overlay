/*
 * Copyright (c) 2023 CATIE
 *
 * SPDX-License-Identifier: Apache-2.0
 */

#include <zephyr/dt-bindings/gpio/sixtron-header.h>

#define PERIPHERAL_ZEST_SENSOR_IMU(port) \
	i2c_zest_sensor_imu_##port: &sixtron_connector_##port##_i2c {};

#define DRIVERS_ZEST_SENSOR_IMU(port) \
	&i2c_zest_sensor_imu_##port { \
		status = "okay"; \
		bma280_zest_sensor_imu_##port: bma280##port@18 { \
			compatible = "bosch,bma280"; \
			reg = <0x18>; \
		}; \
		bme280_zest_sensor_imu_##port: bme280##port@76 { \
			compatible = "bosch,bme280"; \
			reg = <0x76>; \
		}; \
		bmg160_zest_sensor_imu_##port: bmg160##port@68 { \
			compatible = "bosch,bmg160"; \
			reg = <0x68>; \
		}; \
		bno055_zest_sensor_imu_##port: bno055##port@28 { \
			compatible = "bosch,bno055"; \
			reg = <0x28>; \
			irq-gpios = <&sixtron_connector_##port WKUP (GPIO_ACTIVE_HIGH | GPIO_PULL_DOWN)>; \
			use_xtal; \
			zephyr,deferred-init; \
		}; \
		fxas21002_zest_sensor_imu_##port: fxas21002##port@20 { \
			compatible = "nxp,fxas21002"; \
			reg = <0x20>; \
		}; \
	};


#define ZEST_SENSOR_IMU_1_0_2(port) \
	PERIPHERAL_ZEST_SENSOR_IMU(port) \
	DRIVERS_ZEST_SENSOR_IMU(port)
