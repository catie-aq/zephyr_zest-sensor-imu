## boards/shields/zest-sensor-imu/Kconfig.shield
```kconfig
# Copyright (c) 2023 CATIE
# SPDX-License-Identifier: Apache-2.0

config SHIELD_ZEST_SENSOR_IMU
	def_bool $(shields_list_contains,zest_sensor_imu)

config SHIELD_ZEST_SENSOR_IMU_ALT
	def_bool $(shields_list_contains,zest_sensor_imu_alt)

config SHIELD_ZEST_SENSOR_IMU_1_0_2
	def_bool $(shields_list_contains,zest_sensor_imu_1_0_2)

config SHIELD_ZEST_SENSOR_IMU_1_0_2_ALT
	def_bool $(shields_list_contains,zest_sensor_imu_1_0_2_alt)

config SHIELD_ZEST_SENSOR_IMU_3_0_0
	def_bool $(shields_list_contains,zest_sensor_imu_3_0_0)

config SHIELD_ZEST_SENSOR_IMU_4_0_0
	def_bool $(shields_list_contains,zest_sensor_imu_4_0_0)

config SHIELD_ZEST_SENSOR_IMU_4_0_0_ALT
	def_bool $(shields_list_contains,zest_sensor_imu_4_0_0_alt)
```
