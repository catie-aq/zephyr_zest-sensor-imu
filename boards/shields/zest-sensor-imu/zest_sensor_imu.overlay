/*
 * Copyright (c) 2023 CATIE
 *
 * SPDX-License-Identifier: Apache-2.0
 */

#include "zest_sensor_imu_4_0_0.overlay"

#define ZEST_SENSOR_IMU(port) \
	PERIPHERAL_ZEST_SENSOR_IMU(port) \
	DRIVERS_ZEST_SENSOR_IMU(port)
