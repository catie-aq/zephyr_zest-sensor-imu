/*
 * Copyright (c) 2023 CATIE
 *
 * SPDX-License-Identifier: Apache-2.0
 */

#include <zephyr/dt-bindings/gpio/sixtron-header.h>

#define PERIPHERAL_ZEST_SENSOR_IMU(port) \
	i2c_zest_sensor_imu_##port: &sixtron_connector_##port##_i2c {};

#define DRIVERS_ZEST_SENSOR_IMU(port) \
	&i2c_zest_sensor_imu_##port { \
		status = "okay"; \
		ism330dhcx_zest_sensor_imu_##port: ism330dhcx##port@6a { \
			compatible = "st,ism330dhcx"; \
			drdy-gpios = <&sixtron_connector_##port DIO5 GPIO_ACTIVE_HIGH>; \
			reg = <0x6a>; \
		}; \
		iis2mdc_zest_sensor_imu_##port: iis2mdc##port@1e { \
			compatible = "st,iis2mdc"; \
			status = "disabled"; \
			drdy-gpios = <&sixtron_connector_##port DIO7 GPIO_ACTIVE_HIGH>; \
			reg = <0x1e>; \
		}; \
	};


#define ZEST_SENSOR_IMU_4_0_0(port) \
	PERIPHERAL_ZEST_SENSOR_IMU(port) \
	DRIVERS_ZEST_SENSOR_IMU(port)
